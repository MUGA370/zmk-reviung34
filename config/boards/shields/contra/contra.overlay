/*
 * Copyright (c) 2021 The ZMK Contributors
 *
 * SPDX-License-Identifier: MIT
 */

/ {
    chosen {
        zmk,kscan = &kscan0;
    };

    kscan0: kscan_0 {
        compatible = "zmk,kscan-gpio-matrix";
        label = "KSCAN";
        diode-direction = "col2row";

        col-gpios
            = <&pro_micro_a 6 GPIO_ACTIVE_HIGH>
            , <&pro_micro_a 7 GPIO_ACTIVE_HIGH>
            , <&pro_micro_d 5 GPIO_ACTIVE_HIGH>
            , <&pro_micro_d 10 GPIO_ACTIVE_HIGH>
            , <&pro_micro_d 16 GPIO_ACTIVE_HIGH>
            , <&pro_micro_d 14 GPIO_ACTIVE_HIGH>
            , <&pro_micro_d 15 GPIO_ACTIVE_HIGH>
            , <&pro_micro_d 18 GPIO_ACTIVE_HIGH>
            , <&pro_micro_d 19 GPIO_ACTIVE_HIGH>
            , <&pro_micro_d 20 GPIO_ACTIVE_HIGH>
            ;

        row-gpios
            = <&pro_micro_a 4 (GPIO_ACTIVE_HIGH | GPIO_PULL_DOWN)>
            , <&pro_micro_d 8 (GPIO_ACTIVE_HIGH | GPIO_PULL_DOWN)>
            , <&pro_micro_d 9 (GPIO_ACTIVE_HIGH | GPIO_PULL_DOWN)>
            , <&pro_micro_d 3 (GPIO_ACTIVE_HIGH | GPIO_PULL_DOWN)>
            ;
    };
};
